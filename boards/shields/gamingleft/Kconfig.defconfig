## boards/shields/gamingleft/Kconfig.defconfig
```kconfig
if SHIELD_gamingleft_LEFT

config ZMK_KEYBOARD_NAME
    default "gaming-left"

config ZMK_SPLIT_ROLE_CENTRAL
    default y

endif # SHIELD_gamingleft_LEFT

if SHIELD_gamingleft_LEFT || SHIELD_gamingleft_RIGHT

config ZMK_SPLIT
    default y

endif # SHIELD_gamingleft_LEFT || SHIELD_gamingleft_RIGHT
```

## boards/shields/gamingleft/Kconfig.shield
```kconfig
config SHIELD_gamingleft_LEFT
    def_bool $(shields_list_contains,gamingleft_left)

config SHIELD_gamingleft_RIGHT
    def_bool $(shields_list_contains,gamingleft_right)
```

## boards/shields/gamingleft/boards/shields/gamingleft/Kconfig.defconfig
```kconfig
if SHIELD_gamingleft_LEFT

config ZMK_KEYBOARD_NAME
    default "gaming-left"

config ZMK_SPLIT_ROLE_CENTRAL
    default y

endif # SHIELD_gamingleft_LEFT

if SHIELD_gamingleft_LEFT || SHIELD_gamingleft_RIGHT

config ZMK_SPLIT
    default y

endif # SHIELD_gamingleft_LEFT || SHIELD_gamingleft_RIGHT


if SHIELD_VIK_DISPLAY_I2C

if LVGL

config LV_Z_VDB_SIZE
    default 64

config LV_DPI_DEF
    default 148

config LV_Z_BITS_PER_PIXEL
    default 1

choice LV_COLOR_DEPTH
    default LV_COLOR_DEPTH_1
endchoice

endif # LVGL

endif # SHIELD_VIK_DISPLAY_I2C
```

## boards/shields/gamingleft/boards/shields/gamingleft/Kconfig.shield
```kconfig
config SHIELD_gamingleft_LEFT
    def_bool $(shields_list_contains,gamingleft_left)

config SHIELD_gamingleft_RIGHT
    def_bool $(shields_list_contains,gamingleft_right)

config SHIELD_VIK_DISPLAY_I2C
	def_bool $(shields_list_contains,vik_display_i2c)
```
